## sdkconfig.defaults
```kconfig
CONFIG_ESP_DEFAULT_CPU_FREQ_MHZ_240=y
CONFIG_ESP_MAIN_TASK_STACK_SIZE=10240
#CONFIG_ESP_MAIN_TASK_STACK_SIZE=6144
CONFIG_ESP_TASK_WDT_TIMEOUT_S=10

CONFIG_COMPILER_CXX_RTTI=y

#CONFIG_HEAP_POISONING_COMPREHENSIVE=y

CONFIG_SPIRAM=y
CONFIG_ESP32_SPIRAM_SUPPORT=y
CONFIG_SPIRAM_USE=SPIRAM_USE_MEMMAP
CONFIG_SPIRAM_ALLOW_BSS_SEG_EXTERNAL_MEMORY=y
CONFIG_SPIRAM_ALLOW_NOINIT_SEG_EXTERNAL_MEMORY=y
CONFIG_SPIRAM_ALLOW_STACK_EXTERNAL_MEMORY=y
CONFIG_SPIRAM_USE_MEMMAP=y
CONFIG_SPIRAM_USE_MALLOC=y
CONFIG_SPIRAM_MALLOC_ALWAYSINTERNAL=1024
CONFIG_SPIRAM_SPEED_80M=y
CONFIG_SPIRAM_SPEED=80

CONFIG_ESPTOOLPY_FLASHFREQ_80M=y
CONFIG_ESPTOOLPY_FLASHMODE_QIO=y
CONFIG_ESPTOOLPY_FLASHSIZE_4MB=y
CONFIG_ESPTOOLPY_FLASHSIZE="4MB"

CONFIG_PARTITION_TABLE_CUSTOM=y
CONFIG_PARTITION_TABLE_CUSTOM_FILENAME="partitions_custom.csv"

CONFIG_LWIP_NETIF_API=y
```

## sdkconfig.defaults.esp32s3
```kconfig
#CONFIG_IDF_TARGET="esp32s3"
#CONFIG_IDF_TARGET_ESP32S3=y

CONFIG_ESP_DEFAULT_CPU_FREQ_MHZ_240=y
CONFIG_ESP_MAIN_TASK_STACK_SIZE=10240
#CONFIG_ESP_MAIN_TASK_STACK_SIZE=6144
CONFIG_ESP_TASK_WDT_TIMEOUT_S=10

CONFIG_COMPILER_CXX_RTTI=y

#CONFIG_HEAP_POISONING_COMPREHENSIVE=y

CONFIG_SPIRAM=y
#CONFIG_ESP32_SPIRAM_SUPPORT=y
#CONFIG_SPIRAM_USE=SPIRAM_USE_MEMMAP
CONFIG_SPIRAM_ALLOW_BSS_SEG_EXTERNAL_MEMORY=y
CONFIG_SPIRAM_ALLOW_NOINIT_SEG_EXTERNAL_MEMORY=y
CONFIG_SPIRAM_ALLOW_STACK_EXTERNAL_MEMORY=y
CONFIG_SPIRAM_USE_MEMMAP=y
CONFIG_SPIRAM_USE_MALLOC=y
CONFIG_SPIRAM_MALLOC_ALWAYSINTERNAL=1024
CONFIG_SPIRAM_SPEED_80M=y
CONFIG_SPIRAM_SPEED=80
CONFIG_SPIRAM_MODE_OCT=y

CONFIG_ESPTOOLPY_FLASHFREQ_80M=y
CONFIG_ESPTOOLPY_FLASHMODE_QIO=y
CONFIG_ESPTOOLPY_FLASHSIZE_4MB=y
CONFIG_ESPTOOLPY_FLASHSIZE="4MB"

CONFIG_PARTITION_TABLE_CUSTOM=y
CONFIG_PARTITION_TABLE_CUSTOM_FILENAME="partitions_custom.csv"

CONFIG_LWIP_NETIF_API=y


# Tweaks for internet radio:

CONFIG_ESP32_WIFI_STATIC_RX_BUFFER_NUM=16
#CONFIG_ESP32_WIFI_DYNAMIC_RX_BUFFER_NUM=512
CONFIG_ESP32_WIFI_DYNAMIC_RX_BUFFER_NUM=128
CONFIG_ESP32_WIFI_STATIC_TX_BUFFER=y
CONFIG_ESP32_WIFI_TX_BUFFER_TYPE=0
CONFIG_ESP32_WIFI_STATIC_TX_BUFFER_NUM=8
CONFIG_ESP32_WIFI_CACHE_TX_BUFFER_NUM=32
CONFIG_ESP32_WIFI_AMPDU_TX_ENABLED=y
CONFIG_ESP32_WIFI_TX_BA_WIN=16
CONFIG_ESP32_WIFI_AMPDU_RX_ENABLED=y
CONFIG_ESP32_WIFI_RX_BA_WIN=32

#
# LWIP
# 
CONFIG_LWIP_TCP_RECVMBOX_SIZE=512

#
# TCP
#
CONFIG_LWIP_MAX_ACTIVE_TCP=16
CONFIG_LWIP_MAX_LISTENING_TCP=16
CONFIG_TCP_MAXRTX=12
CONFIG_TCP_SYNMAXRTX=6
CONFIG_TCP_MSS=1436
CONFIG_TCP_MSL=60000
CONFIG_TCP_SND_BUF_DEFAULT=65535
#CONFIG_TCP_WND_DEFAULT=512000
CONFIG_TCP_WND_DEFAULT=65535
#CONFIG_TCP_RECVMBOX_SIZE=512
CONFIG_TCP_RECVMBOX_SIZE=64
CONFIG_TCP_QUEUE_OOSEQ=y
#CONFIG_ESP_TCP_KEEP_CONNECTION_WHEN_IP_CHANGES=
CONFIG_TCP_OVERSIZE_MSS=y
#CONFIG_TCP_OVERSIZE_QUARTER_MSS=
#CONFIG_TCP_OVERSIZE_DISABLE=
CONFIG_LWIP_WND_SCALE=y
#CONFIG_TCP_RCV_SCALE=3
```
